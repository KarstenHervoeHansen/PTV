{Unit RGB72801;}

(*
 Denne unit indeholder f›lgende procedurer:
 Bruges til styring af RGB-generator 7108 100 72801 (SONY BVM 1310/1410)
INTERFACE
PROCEDURE  EBUWhite;
PROCEDURE  EBURed;
PROCEDURE  EBUGreen;
PROCEDURE  EBUBlue;
PROCEDURE  EBUBlack;
PROCEDURE  SMPTEWhite;
PROCEDURE  SMPTERed;
PROCEDURE  SMPTEGreen;
PROCEDURE  SMPTEBlue;
PROCEDURE  SMPTEBlack;
PROCEDURE  CRT625Lines;
PROCEDURE  CRT525Lines;
PROCEDURE  RGBGenRemote;
PROCEDURE  RGBGenLocal;


IMPLEMENTATION
*)

PROCEDURE EBUWhite;
BEGIN
{$IFDEF RGBGEN}
 IICPort66 := IICPort66 OR $07;
 Trm8574(I2CIOAddr,66,IICPort66,St);   Delay(10);
{$ENDIF}
END;

PROCEDURE EBURed;
BEGIN
{$IFDEF RGBGEN}
 IICPort66 := (IICPort66 AND $F8) OR $01;
 Trm8574(I2CIOAddr,66,IICPort66,St);   Delay(10);
{$ENDIF}
END;

PROCEDURE EBUGreen;
BEGIN
{$IFDEF RGBGEN}
 IICPort66 := (IICPort66 AND $F8) OR $02;
 Trm8574(I2CIOAddr,66,IICPort66,St);   Delay(10);
{$ENDIF}
END;

PROCEDURE EBUBlue;
BEGIN
{$IFDEF RGBGEN}
 IICPort66 := (IICPort66 AND $F8) OR $04;
 Trm8574(I2CIOAddr,66,IICPort66,St);   Delay(10);
{$ENDIF}
END;

PROCEDURE EBUBlack;
BEGIN
{$IFDEF RGBGEN}
 IICPort66 := IICPort66 AND $F8;
 Trm8574(I2CIOAddr,66,IICPort66,St);   Delay(10);
{$ENDIF}
END;

PROCEDURE SMPTEWhite;
BEGIN
{$IFDEF RGBGEN}
 IICPort66 := IICPort66 OR $38;
 Trm8574(I2CIOAddr,66,IICPort66,St);   Delay(10);
{$ENDIF}
END;

PROCEDURE SMPTERed;
BEGIN
{$IFDEF RGBGEN}
 IICPort66 := (IICPort66 AND $C7) OR $08;
 Trm8574(I2CIOAddr,66,IICPort66,St);   Delay(10);
{$ENDIF}
END;

PROCEDURE SMPTEGreen;
BEGIN
{$IFDEF RGBGEN}
 IICPort66 := (IICPort66 AND $C7) OR $10;
 Trm8574(I2CIOAddr,66,IICPort66,St);   Delay(10);
{$ENDIF}
END;

PROCEDURE SMPTEBlue;
BEGIN
{$IFDEF RGBGEN}
 IICPort66 := (IICPort66 AND $C7) OR $20;
 Trm8574(I2CIOAddr,66,IICPort66,St);   Delay(10);
{$ENDIF}
END;

PROCEDURE SMPTEBlack;
BEGIN
{$IFDEF RGBGEN}
 IICPort66 := IICPort66 AND $C7;
 Trm8574(I2CIOAddr,66,IICPort66,St);   Delay(10);
{$ENDIF}
END;

PROCEDURE CRT625Lines;
BEGIN
{$IFDEF RGBGEN}
 IICPort66 := IICPort66 OR $40;
 Trm8574(I2CIOAddr,66,IICPort66,St);   Delay(10);
{$ENDIF}
END;

PROCEDURE CRT525Lines;
BEGIN
{$IFDEF RGBGEN}
 IICPort66 := IICPort66 AND $BF;
 Trm8574(I2CIOAddr,66,IICPort66,St);   Delay(10);
{$ENDIF}
END;

PROCEDURE RGBGenRemote;
BEGIN
{$IFDEF RGBGEN}
 IICPort66 := IICPort66 AND $7F;
 Trm8574(I2CIOAddr,66,IICPort66,St);   Delay(10);
{$ENDIF}
END;

PROCEDURE RGBGenLocal;
BEGIN
{$IFDEF RGBGEN}
 IICPort66 := IICPort66 OR $80;
 Trm8574(I2CIOAddr,66,IICPort66,St);   Delay(10);
{$ENDIF}
END;


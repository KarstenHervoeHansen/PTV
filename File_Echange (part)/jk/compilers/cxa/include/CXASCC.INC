;*
;*	@(#)cxascc.inc	1.4 11/26/97
;*

;*****************************************************************************
;*
;*  FILE        :  cxascc.inc
;*
;* DESCRIPTION	: Assembler definitions for the XA-SCC Memory Mapped Registers (MMR).
;*		
;*		  The MMR Base address is defined by MMRBASE. The MMRBASE is
;*		  default set to 0xf000.
;*
;* COPYRIGHT	: 1997 TASKING, Inc.
;*	
;*****************************************************************************

;
; MMR Base Address
;
MMRBASE    EQU 0F000h

;
;	DMA registers
;
SCC0RXCON      EQU MMRBASE+100h
SCC0RXSTAT     EQU MMRBASE+101h
SCC0RXSEG      EQU MMRBASE+102h
SCC0RXBUFBASE  EQU MMRBASE+104h
SCC0RXBUFBOUND EQU MMRBASE+106h
SCC0RXADDPTR   EQU MMRBASE+108h
SCC0RXCOUNT    EQU MMRBASE+10Ah
SCC0RXDATALO   EQU MMRBASE+10Ch
SCC0RXDATAHI   EQU MMRBASE+10Eh
SCC1RXCON      EQU MMRBASE+110h
SCC1RXSTAT     EQU MMRBASE+111h
SCC1RXSEG      EQU MMRBASE+112h
SCC1RXBUFBASE  EQU MMRBASE+114h
SCC1RXBUFBOUND EQU MMRBASE+116h
SCC1RXADDPTR   EQU MMRBASE+118h
SCC1RXCOUNT    EQU MMRBASE+11Ah
SCC1RXDATALO   EQU MMRBASE+11Ch
SCC1RXDATAHI   EQU MMRBASE+11Eh
SCC2RXCON      EQU MMRBASE+120h
SCC2RXSTAT     EQU MMRBASE+121h
SCC2RXSEG      EQU MMRBASE+122h
SCC2RXBUFBASE  EQU MMRBASE+124h
SCC2RXBUFBOUND EQU MMRBASE+126h
SCC2RXADDPTR   EQU MMRBASE+128h
SCC2RXCOUNT    EQU MMRBASE+12Ah
SCC2RXDATALO   EQU MMRBASE+12Ch
SCC2RXDATAHI   EQU MMRBASE+12Eh
SCC3RXCON      EQU MMRBASE+130h
SCC3RXSTAT     EQU MMRBASE+131h
SCC3RXSEG      EQU MMRBASE+132h
SCC3RXBUFBASE  EQU MMRBASE+134h
SCC3RXBUFBOUND EQU MMRBASE+136h
SCC3RXADDPTR   EQU MMRBASE+138h
SCC3RXCOUNT    EQU MMRBASE+13Ah
SCC3RXDATALO   EQU MMRBASE+13Ch
SCC3RXDATAHI   EQU MMRBASE+13Eh
SCC0TXCON      EQU MMRBASE+140h
SCC0TXSTAT     EQU MMRBASE+141h
SCC0TXSEG      EQU MMRBASE+142h
SCC0TXBUFBASE  EQU MMRBASE+144h
SCC0TXBUFBOUND EQU MMRBASE+146h
SCC0TXADDPTR   EQU MMRBASE+148h
SCC0TXCOUNT    EQU MMRBASE+14Ah
SCC0TXDATALO   EQU MMRBASE+14Ch
SCC0TXDATAHI   EQU MMRBASE+14Eh
SCC1TXCON      EQU MMRBASE+150h
SCC1TXSTAT     EQU MMRBASE+151h
SCC1TXSEG      EQU MMRBASE+152h
SCC1TXBUFBASE  EQU MMRBASE+154h
SCC1TXBUFBOUND EQU MMRBASE+156h
SCC1TXADDPTR   EQU MMRBASE+158h
SCC1TXCOUNT    EQU MMRBASE+15Ah
SCC1TXDATALO   EQU MMRBASE+15Ch
SCC1TXDATAHI   EQU MMRBASE+15Eh
SCC2TXCON      EQU MMRBASE+160h
SCC2TXSTAT     EQU MMRBASE+161h
SCC2TXSEG      EQU MMRBASE+162h
SCC2TXBUFBASE  EQU MMRBASE+164h
SCC2TXBUFBOUND EQU MMRBASE+166h
SCC2TXADDPTR   EQU MMRBASE+168h
SCC2TXCOUNT    EQU MMRBASE+16Ah
SCC2TXDATALO   EQU MMRBASE+16Ch
SCC2TXDATAHI   EQU MMRBASE+16Eh
SCC3TXCON      EQU MMRBASE+170h
SCC3TXSTAT     EQU MMRBASE+171h
SCC3TXSEG      EQU MMRBASE+172h
SCC3TXBUFBASE  EQU MMRBASE+174h
SCC3TXBUFBOUND EQU MMRBASE+176h
SCC3TXADDPTR   EQU MMRBASE+178h
SCC3TXCOUNT    EQU MMRBASE+17Ah
SCC3TXDATALO   EQU MMRBASE+17Ch
SCC3TXDATAHI   EQU MMRBASE+17Eh
SCC0RXTIMEOUT  EQU MMRBASE+200h
SCC1RXTIMEOUT  EQU MMRBASE+202h
SCC2RXTIMEOUT  EQU MMRBASE+204h
SCC3RXTIMEOUT  EQU MMRBASE+206h
G_DMA_INT      EQU MMRBASE+210h

;
;	V.54 2047 Unit registers
;
VACS       EQU MMRBASE+240h
VACFG      EQU MMRBASE+241h
VATCL      EQU MMRBASE+242h
VATCH      EQU MMRBASE+243h
VAEC       EQU MMRBASE+244h
VBCS       EQU MMRBASE+248h
VBCFG      EQU MMRBASE+249h
VBTCL      EQU MMRBASE+24Ah
VBTCH      EQU MMRBASE+24Bh
VBEC       EQU MMRBASE+24Ch

;
;	SCP/SPI registers
;
SPCFG      EQU MMRBASE+260h
SPD        EQU MMRBASE+262h
SPCS       EQU MMRBASE+263h

;
;	Autobaud registers
;
BDAEE      EQU MMRBASE+270h
BDCS       EQU MMRBASE+272h

;
;	MIF Registers
;
B0CFG      EQU MMRBASE+280h
B0AM       EQU MMRBASE+281h
B0TMG      EQU MMRBASE+282h
B1CFG      EQU MMRBASE+284h
B1AM       EQU MMRBASE+285h
B1TMG      EQU MMRBASE+286h
B2CFG      EQU MMRBASE+288h
B2AM       EQU MMRBASE+289h
B2TMG      EQU MMRBASE+28Ah
B3CFG      EQU MMRBASE+28Ch
B3AM       EQU MMRBASE+28Dh
B3TMG      EQU MMRBASE+28Eh
B4CFG      EQU MMRBASE+290h
B4AM       EQU MMRBASE+291h
B4TMG      EQU MMRBASE+292h
B5CFG      EQU MMRBASE+294h
B5AM       EQU MMRBASE+295h
B5TMG      EQU MMRBASE+296h
MBCL       EQU MMRBASE+2BEh
RFSH       EQU MMRBASE+2BFh

;
;	IDL Stuff
;
SIMODE     EQU MMRBASE+2C0h
SIMASK     EQU MMRBASE+2C2h
SOFTINTPM  EQU MMRBASE+2D0h
XINT2      EQU MMRBASE+2D2h

;
;	SCC Registers
;
SCC0WR0    EQU MMRBASE+800h
SCC0WR1    EQU MMRBASE+802h
SCC0WR7P   EQU MMRBASE+804h
SCC0WR3    EQU MMRBASE+806h
SCC0WR4    EQU MMRBASE+808h
SCC0WR5    EQU MMRBASE+80Ah
SCC0WR6    EQU MMRBASE+80Ch
SCC0WR7    EQU MMRBASE+80Eh
SCC0WR8    EQU MMRBASE+810h
SCC0WR9    EQU MMRBASE+812h
SCC0WR10   EQU MMRBASE+814h
SCC0WR11   EQU MMRBASE+816h
SCC0WR12   EQU MMRBASE+818h
SCC0WR13   EQU MMRBASE+81Ah
SCC0WR14   EQU MMRBASE+81Ch
SCC0WR15   EQU MMRBASE+81Eh
SCC0RR0    EQU MMRBASE+820h
SCC0RR1    EQU MMRBASE+822h
SCC0RR6    EQU MMRBASE+82Ch
SCC0RR7    EQU MMRBASE+82Eh
SCC0RR8    EQU MMRBASE+830h
SCC0RR10   EQU MMRBASE+834h
SCC1WR0    EQU MMRBASE+840h
SCC1WR1    EQU MMRBASE+842h
SCC1WR7P   EQU MMRBASE+844h
SCC1WR3    EQU MMRBASE+846h
SCC1WR4    EQU MMRBASE+848h
SCC1WR5    EQU MMRBASE+84Ah
SCC1WR6    EQU MMRBASE+84Ch
SCC1WR7    EQU MMRBASE+84Eh
SCC1WR8    EQU MMRBASE+850h
SCC1WR9    EQU MMRBASE+852h
SCC1WR10   EQU MMRBASE+854h
SCC1WR11   EQU MMRBASE+856h
SCC1WR12   EQU MMRBASE+858h
SCC1WR13   EQU MMRBASE+85Ah
SCC1WR14   EQU MMRBASE+85Ch
SCC1WR15   EQU MMRBASE+85Eh
SCC1RR0    EQU MMRBASE+860h
SCC1RR1    EQU MMRBASE+862h
SCC1RR6    EQU MMRBASE+86Ch
SCC1RR7    EQU MMRBASE+86Eh
SCC1RR8    EQU MMRBASE+870h
SCC2WR0    EQU MMRBASE+880h
SCC2WR1    EQU MMRBASE+882h
SCC2WR7P   EQU MMRBASE+884h
SCC2WR3    EQU MMRBASE+886h
SCC2WR4    EQU MMRBASE+888h
SCC2WR5    EQU MMRBASE+88Ah
SCC2WR6    EQU MMRBASE+88Ch
SCC2WR7    EQU MMRBASE+88Eh
SCC2WR8    EQU MMRBASE+890h
SCC2WR9    EQU MMRBASE+892h
SCC2WR10   EQU MMRBASE+894h
SCC2WR11   EQU MMRBASE+896h
SCC2WR12   EQU MMRBASE+898h
SCC2WR13   EQU MMRBASE+89Ah
SCC2WR14   EQU MMRBASE+89Ch
SCC2WR15   EQU MMRBASE+89Eh
SCC2RR0    EQU MMRBASE+8A0h
SCC2RR1    EQU MMRBASE+8A2h
SCC2RR6    EQU MMRBASE+8ACh
SCC2RR7    EQU MMRBASE+8AEh
SCC2RR8    EQU MMRBASE+8B0h
SCC2RR10   EQU MMRBASE+8B4h
SCC3WR0    EQU MMRBASE+8C0h
SCC3WR1    EQU MMRBASE+8C2h
SCC3WR7P   EQU MMRBASE+8C4h
SCC3WR3    EQU MMRBASE+8C6h
SCC3WR4    EQU MMRBASE+8C8h
SCC3WR5    EQU MMRBASE+8CAh
SCC3WR6    EQU MMRBASE+8CCh
SCC3WR7    EQU MMRBASE+8CEh
SCC3WR8    EQU MMRBASE+8D0h
SCC3WR9    EQU MMRBASE+8D2h
SCC3WR10   EQU MMRBASE+8D4h
SCC3WR11   EQU MMRBASE+8D6h
SCC3WR12   EQU MMRBASE+8D8h
SCC3WR13   EQU MMRBASE+8DAh
SCC3WR14   EQU MMRBASE+8DCh
SCC3WR15   EQU MMRBASE+8DEh
SCC3RR0    EQU MMRBASE+8E0h
SCC3RR1    EQU MMRBASE+8E2h
SCC3RR6    EQU MMRBASE+8ECh
SCC3RR7    EQU MMRBASE+8EEh
SCC3RR8    EQU MMRBASE+8F0h
SCC3RR10   EQU MMRBASE+8F4h
